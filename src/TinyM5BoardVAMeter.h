// TinyM5BoardVAMeter
//
// A volt and current meter with a square screen. Same panel bus as
// the Cardputer - upstream tells the two apart by probing GPIO 5
// and 6 - but 240x240 rather than 135x240, and a different
// backlight curve.
// No battery: it runs from what it is measuring. The INA-style
// sensors on the internal bus are devices, not bring-up.
//
// Generated by tools/gen_boards.py - edit the catalogue there, not this file.
#pragma once

#ifdef TINYM5_BOARD
#error "TinyM5Board: one board per sketch. A second board header was included, and only the first one would have taken effect - name the one you meant."
#endif

#include <Wire.h>

#include "TinyM5Board/Common.h"
#include "TinyM5Board/Button.h"
#include "TinyM5Board/BacklightPwm.h"

class TinyM5BoardVAMeter {
 public:
  // ---- identity ----
  static constexpr TinyM5::BoardId kBoardId = TinyM5::BoardId::VAMeter;
  static constexpr TinyM5::Family kFamily = TinyM5::Family::Other;
  static constexpr const char *kName = "M5VAMeter";

  // ---- pins ----
  static constexpr int8_t kI2cSda = 5;
  static constexpr int8_t kI2cScl = 6;
  static constexpr int8_t kI2cExtSda = 8;
  static constexpr int8_t kI2cExtScl = 9;
  static constexpr int8_t kPowerHold = -1;
  /// -1: no card on the panel's SPI bus.
  static constexpr int8_t kSdSpiCs = -1;
  static constexpr int8_t kRgbLed = -1;
  static constexpr uint8_t kRgbLedCount = 0;
  static constexpr int8_t kBtnA = 2;
  static constexpr int8_t kBtnB = 0;

  // ---- what this board has ----
  // Derived from the catalogue columns, so a flag cannot disagree
  // with the thing it describes.
  static constexpr bool kHasDisplay = true;
  static constexpr bool kHasBacklight = true;
  static constexpr bool kHasBattery = false;
  static constexpr bool kHasInternalI2c = true;
  static constexpr bool kHasExternalI2c = true;
  static constexpr bool kSharesI2cBus = false;

  // ---- backlight ----
  TinyM5BoardBacklightPwm Backlight{38, 512, 64};

  // ---- buttons ----
  TinyM5BoardButton BtnA{[] { return digitalRead(kBtnA) == LOW; }};
  TinyM5BoardButton BtnB{[] { return digitalRead(kBtnB) == LOW; }};

  bool begin(uint8_t flags = TinyM5::InitDefault)
  {
    if (!(flags & TinyM5::KeepSerial)) {
      Serial.begin(115200);
    }
    if (!(flags & TinyM5::KeepI2c)) {
      Wire.begin(kI2cSda, kI2cScl);
      Wire1.begin(kI2cExtSda, kI2cExtScl);
    }
    pinMode(kBtnA, INPUT_PULLUP);
    pinMode(kBtnB, INPUT_PULLUP);
    TinyM5::resetPulse(33);
    Backlight.begin();
    return true;
  }

  void update()
  {
    const uint32_t ms = millis();
    BtnA.update(ms);
    BtnB.update(ms);
  }

  /// Everything a graphics library needs to drive this panel. This
  /// library owns no driver and draws nothing.
  static constexpr TinyM5::Display display()
  {
    return TinyM5::Display{
        /*bus*/ TinyM5::DisplayBus::Spi,
        /*mosi*/ 35, /*miso*/ -1, /*sclk*/ 36,
        /*dc*/ 34, /*cs*/ 37,
        /*io2*/ -1, /*io3*/ -1,
        /*rst*/ -1,  // begin() has already pulsed it
        /*busy*/ -1,
        /*freqWrite*/ 40000000, /*freqRead*/ 16000000,
        /*width*/ 240, /*height*/ 240,
        /*offsetX*/ 0, /*offsetY*/ 0,
        /*rotation*/ 0, /*invert*/ true,
        /*threeWire*/ true};
  }

  static constexpr const char *getBoardName() { return kName; }
  static constexpr TinyM5::BoardId getBoard() { return kBoardId; }

  static constexpr int8_t getPin(TinyM5::Pin pin)
  {
    switch (pin) {
      case TinyM5::Pin::InI2cSda: return kI2cSda;
      case TinyM5::Pin::InI2cScl: return kI2cScl;
      case TinyM5::Pin::ExI2cSda: return kI2cExtSda;
      case TinyM5::Pin::ExI2cScl: return kI2cExtScl;
      case TinyM5::Pin::RgbLed: return kRgbLed;
      case TinyM5::Pin::PowerHold: return kPowerHold;
    }
    return -1;
  }
};

// The same answers for the preprocessor.
//
// `if constexpr` cannot stand in for these. Outside a template both
// arms of an `if constexpr` still go through name lookup, so a sketch
// that reaches for Board.Power on a board without a battery fails to
// compile even in the branch that is discarded. Absent hardware is
// absent rather than stubbed out, so portable sketches need #if.
#define TINYM5_HAS_DISPLAY 1
#define TINYM5_HAS_BACKLIGHT 1
#define TINYM5_HAS_BATTERY 0
#define TINYM5_HAS_INTERNAL_I2C 1
#define TINYM5_HAS_EXTERNAL_I2C 1
#define TINYM5_HAS_RGB_LED 0
#define TINYM5_HAS_BTN_A 1
#define TINYM5_HAS_BTN_B 1
#define TINYM5_HAS_BTN_C 0
#define TINYM5_HAS_BTN_PWR 0

// The board this sketch drives, written once so that portable code can
// name it without naming the product.
#define TINYM5_BOARD TinyM5BoardVAMeter

#ifndef TINYM5_NO_GLOBAL_BOARD
// Deliberately not called `M5`: M5Unified defines a global of that name
// (M5Unified.cpp:58), so sharing it would break any sketch that also
// pulls in one of the official Unit libraries.
inline TinyM5BoardVAMeter Board;
#endif
