// TinyM5BoardNanoC6
//
// An ESP32-C6 with a USB-A plug. Only the Grove port, so that is
// what Wire opens.
// The blue status LED on GPIO 7 is a device rather than a rail -
// M5Unified drives it through setLed() - so bring-up leaves it
// alone. The RGB LED here is the one on GPIO 20.
//
// Generated by tools/gen_boards.py - edit the catalogue there, not this file.
#pragma once

#ifdef TINYM5_BOARD
#error "TinyM5Board: one board per sketch. A second board header was included, and only the first one would have taken effect - name the one you meant."
#endif

#include <Wire.h>

#include "TinyM5Board/Common.h"
#include "TinyM5Board/Button.h"

class TinyM5BoardNanoC6 {
 public:
  // ---- identity ----
  static constexpr TinyM5::BoardId kBoardId = TinyM5::BoardId::NanoC6;
  static constexpr TinyM5::Family kFamily = TinyM5::Family::Other;
  static constexpr const char *kName = "M5NanoC6";

  // ---- pins ----
  static constexpr int8_t kI2cSda = -1;
  static constexpr int8_t kI2cScl = -1;
  static constexpr int8_t kI2cExtSda = 2;
  static constexpr int8_t kI2cExtScl = 1;
  static constexpr int8_t kPowerHold = -1;
  /// -1: no card on the panel's SPI bus.
  static constexpr int8_t kSdSpiCs = -1;
  static constexpr int8_t kRgbLed = 20;
  static constexpr uint8_t kRgbLedCount = 1;
  static constexpr int8_t kBtnA = 9;

  // ---- what this board has ----
  // Derived from the catalogue columns, so a flag cannot disagree
  // with the thing it describes.
  static constexpr bool kHasDisplay = false;
  static constexpr bool kHasBacklight = false;
  static constexpr bool kHasBattery = false;
  static constexpr bool kHasInternalI2c = false;
  static constexpr bool kHasExternalI2c = true;
  static constexpr bool kSharesI2cBus = false;

  // ---- buttons ----
  TinyM5BoardButton BtnA{[] { return digitalRead(kBtnA) == LOW; }};

  bool begin(uint8_t flags = TinyM5::InitDefault)
  {
    if (!(flags & TinyM5::KeepSerial)) {
      Serial.begin(115200);
    }
    if (!(flags & TinyM5::KeepI2c)) {
      Wire.begin(kI2cExtSda, kI2cExtScl);
    }
    pinMode(kBtnA, INPUT_PULLUP);
    return true;
  }

  void update()
  {
    const uint32_t ms = millis();
    BtnA.update(ms);
  }

  static constexpr const char *getBoardName() { return kName; }
  static constexpr TinyM5::BoardId getBoard() { return kBoardId; }

  static constexpr int8_t getPin(TinyM5::Pin pin)
  {
    switch (pin) {
      case TinyM5::Pin::InI2cSda: return kI2cSda;
      case TinyM5::Pin::InI2cScl: return kI2cScl;
      case TinyM5::Pin::ExI2cSda: return kI2cExtSda;
      case TinyM5::Pin::ExI2cScl: return kI2cExtScl;
      case TinyM5::Pin::RgbLed: return kRgbLed;
      case TinyM5::Pin::PowerHold: return kPowerHold;
    }
    return -1;
  }
};

// The same answers for the preprocessor.
//
// `if constexpr` cannot stand in for these. Outside a template both
// arms of an `if constexpr` still go through name lookup, so a sketch
// that reaches for Board.Power on a board without a battery fails to
// compile even in the branch that is discarded. Absent hardware is
// absent rather than stubbed out, so portable sketches need #if.
#define TINYM5_HAS_DISPLAY 0
#define TINYM5_HAS_BACKLIGHT 0
#define TINYM5_HAS_BATTERY 0
#define TINYM5_HAS_INTERNAL_I2C 0
#define TINYM5_HAS_EXTERNAL_I2C 1
#define TINYM5_HAS_RGB_LED 1
#define TINYM5_HAS_BTN_A 1
#define TINYM5_HAS_BTN_B 0
#define TINYM5_HAS_BTN_C 0
#define TINYM5_HAS_BTN_PWR 0

// The board this sketch drives, written once so that portable code can
// name it without naming the product.
#define TINYM5_BOARD TinyM5BoardNanoC6

#ifndef TINYM5_NO_GLOBAL_BOARD
// Deliberately not called `M5`: M5Unified defines a global of that name
// (M5Unified.cpp:58), so sharing it would break any sketch that also
// pulls in one of the official Unit libraries.
inline TinyM5BoardNanoC6 Board;
#endif
