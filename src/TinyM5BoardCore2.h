// TinyM5BoardCore2
//
// Two different power chips ship under this one name: the v1.0 has
// an AXP192 and the v1.1 an AXP2101, at the same address, and they
// feed the panel from different rails. begin() asks which it is
// rather than guessing - define TINYM5_CORE2_PMIC_AXP2101 (or
// _AXP192) to skip the question and drop the other driver.
// Its A/B/C are touch zones, not GPIOs, so only the power key is
// here. The SD card shares the LCD's SPI bus and is not yet taken
// out of SD mode - see docs/DEVELOPMENT_PLAN.ja.md.
// The panel is an ILI9342C or an ILI9342E depending on the unit,
// which is read from the touch controller's firmware id - a
// graphics library's job, so no panel type is reported here.
//
// Generated by tools/gen_boards.py - edit the catalogue there, not this file.
#pragma once

#ifdef TINYM5_BOARD
#error "TinyM5Board: one board per sketch. A second board header was included, and only the first one would have taken effect - name the one you meant."
#endif

#include <Wire.h>

#include "TinyM5Board/Common.h"
#include "TinyM5Board/Button.h"
#include "TinyM5Board/PowerCore2.h"
#include "TinyM5Board/BacklightCore2.h"

class TinyM5BoardCore2 {
 public:
  // ---- identity ----
  static constexpr TinyM5::BoardId kBoardId = TinyM5::BoardId::Core2;
  static constexpr TinyM5::Family kFamily = TinyM5::Family::Core;
  static constexpr const char *kName = "M5StackCore2";

  // ---- pins ----
  static constexpr int8_t kI2cSda = 21;
  static constexpr int8_t kI2cScl = 22;
  static constexpr int8_t kI2cExtSda = 32;
  static constexpr int8_t kI2cExtScl = 33;
  static constexpr int8_t kPowerHold = -1;
  static constexpr int8_t kRgbLed = 25;
  static constexpr uint8_t kRgbLedCount = 1;
  static constexpr int8_t kBtnPwr = -1;

  // ---- what this board has ----
  // Derived from the catalogue columns, so a flag cannot disagree
  // with the thing it describes.
  static constexpr bool kHasDisplay = true;
  static constexpr bool kHasBacklight = true;
  static constexpr bool kHasBattery = true;
  static constexpr bool kHasInternalI2c = true;
  static constexpr bool kHasExternalI2c = true;
  static constexpr bool kSharesI2cBus = false;

  // ---- power ----
  // Two chips are possible under this one product name, so the
  // bring-up, the panel reset and the backlight all live behind
  // this one object. It asks the chip which it is.
  TinyM5BoardPowerCore2 Power;

  // ---- backlight ----
  TinyM5BoardBacklightCore2 Backlight{Power};

  // ---- buttons ----
  // Some of these are not pins on the SoC - they live in the
  // power chip or the expander and are read over I2C, so those
  // are rate limited to the debounce interval.
  TinyM5BoardButton BtnPwr{
      [](void *p) {
        return static_cast<TinyM5BoardPowerCore2 *>(p)->isKeyPressed();
      },
      &Power, true};

  bool begin(uint8_t flags = TinyM5::InitDefault)
  {
    if (!(flags & TinyM5::KeepSerial)) {
      Serial.begin(115200);
    }
    if (!(flags & TinyM5::KeepI2c)) {
      Wire.begin(kI2cSda, kI2cScl);
      Wire1.begin(kI2cExtSda, kI2cExtScl);
    }
    // Asks the chip which of the two it is, then runs that one's
    // bring-up - including the panel reset, which is a rail on one
    // chip and a chip GPIO on the other.
    const bool ok = Power.begin(Wire);
    Backlight.begin();
    return ok;
  }

  void update()
  {
    const uint32_t ms = millis();
    BtnPwr.update(ms);
  }

  /// Everything a graphics library needs to drive this panel. This
  /// library owns no driver and draws nothing.
  static constexpr TinyM5::Display display()
  {
    return TinyM5::Display{
        /*mosi*/ 23, /*miso*/ 38, /*sclk*/ 18,
        /*dc*/ 15, /*cs*/ 5,
        /*rst*/ -1,  // begin() has already pulsed it
        /*freqWrite*/ 40000000, /*freqRead*/ 16000000,
        /*width*/ 320, /*height*/ 240,
        /*offsetX*/ 0, /*offsetY*/ 0,
        /*rotation*/ 3, /*invert*/ true,
        /*threeWire*/ true};
  }

  static constexpr const char *getBoardName() { return kName; }
  static constexpr TinyM5::BoardId getBoard() { return kBoardId; }

  static constexpr int8_t getPin(TinyM5::Pin pin)
  {
    switch (pin) {
      case TinyM5::Pin::InI2cSda: return kI2cSda;
      case TinyM5::Pin::InI2cScl: return kI2cScl;
      case TinyM5::Pin::ExI2cSda: return kI2cExtSda;
      case TinyM5::Pin::ExI2cScl: return kI2cExtScl;
      case TinyM5::Pin::RgbLed: return kRgbLed;
      case TinyM5::Pin::PowerHold: return kPowerHold;
    }
    return -1;
  }
};

// The same answers for the preprocessor.
//
// `if constexpr` cannot stand in for these. Outside a template both
// arms of an `if constexpr` still go through name lookup, so a sketch
// that reaches for Board.Power on a board without a battery fails to
// compile even in the branch that is discarded. Absent hardware is
// absent rather than stubbed out, so portable sketches need #if.
#define TINYM5_HAS_DISPLAY 1
#define TINYM5_HAS_BACKLIGHT 1
#define TINYM5_HAS_BATTERY 1
#define TINYM5_HAS_INTERNAL_I2C 1
#define TINYM5_HAS_EXTERNAL_I2C 1
#define TINYM5_HAS_RGB_LED 1
#define TINYM5_HAS_BTN_A 0
#define TINYM5_HAS_BTN_B 0
#define TINYM5_HAS_BTN_C 0
#define TINYM5_HAS_BTN_PWR 1

// The board this sketch drives, written once so that portable code can
// name it without naming the product.
#define TINYM5_BOARD TinyM5BoardCore2

#ifndef TINYM5_NO_GLOBAL_BOARD
// Deliberately not called `M5`: M5Unified defines a global of that name
// (M5Unified.cpp:58), so sharing it would break any sketch that also
// pulls in one of the official Unit libraries.
inline TinyM5BoardCore2 Board;
#endif
