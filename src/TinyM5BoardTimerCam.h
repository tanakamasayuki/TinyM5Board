// TinyM5BoardTimerCam
//
// A camera on a battery, with no screen and no buttons.
// Its divider is 1.513 rather than the usual 2, which is why the
// ratio is a column and not a constant.
//
// Generated by tools/gen_boards.py - edit the catalogue there, not this file.
#pragma once

#ifdef TINYM5_BOARD
#error "TinyM5Board: one board per sketch. A second board header was included, and only the first one would have taken effect - name the one you meant."
#endif

#include <Wire.h>

#include "TinyM5Board/Common.h"
#include "TinyM5Board/PowerAdc.h"

class TinyM5BoardTimerCam {
 public:
  // ---- identity ----
  static constexpr TinyM5::BoardId kBoardId = TinyM5::BoardId::TimerCam;
  static constexpr TinyM5::Family kFamily = TinyM5::Family::Other;
  static constexpr const char *kName = "M5TimerCam";

  // ---- pins ----
  static constexpr int8_t kI2cSda = 12;
  static constexpr int8_t kI2cScl = 14;
  static constexpr int8_t kI2cExtSda = 4;
  static constexpr int8_t kI2cExtScl = 13;
  static constexpr int8_t kPowerHold = 33;
  /// -1: no card on the panel's SPI bus.
  static constexpr int8_t kSdSpiCs = -1;
  static constexpr int8_t kRgbLed = -1;
  static constexpr uint8_t kRgbLedCount = 0;

  // ---- what this board has ----
  // Derived from the catalogue columns, so a flag cannot disagree
  // with the thing it describes.
  static constexpr bool kHasDisplay = false;
  static constexpr bool kHasBacklight = false;
  static constexpr bool kHasBattery = true;
  static constexpr bool kHasInternalI2c = true;
  static constexpr bool kHasExternalI2c = true;
  static constexpr bool kSharesI2cBus = false;

  // ---- power ----
  TinyM5BoardPowerAdc Power{38, 1513};

  bool begin(uint8_t flags = TinyM5::InitDefault)
  {
    holdPower();
    if (!(flags & TinyM5::KeepSerial)) {
      Serial.begin(115200);
    }
    if (!(flags & TinyM5::KeepI2c)) {
      Wire.begin(kI2cSda, kI2cScl);
      Wire1.begin(kI2cExtSda, kI2cExtScl);
    }
    Power.begin();
    // The status LED comes up lit. Leaving it on would burn current on a
    // board that runs from a battery. (M5Unified Power_Class.cpp:612)
    pinMode(2, OUTPUT);
    digitalWrite(2, LOW);
    return true;
  }

  /// Latch the power rail on. Called by begin(), and safe to call
  /// first thing in setup() when begin() cannot run that early.
  static void holdPower()
  {
    pinMode(kPowerHold, OUTPUT);
    digitalWrite(kPowerHold, HIGH);
  }

  void update()
  {
  }

  static constexpr const char *getBoardName() { return kName; }
  static constexpr TinyM5::BoardId getBoard() { return kBoardId; }

  static constexpr int8_t getPin(TinyM5::Pin pin)
  {
    switch (pin) {
      case TinyM5::Pin::InI2cSda: return kI2cSda;
      case TinyM5::Pin::InI2cScl: return kI2cScl;
      case TinyM5::Pin::ExI2cSda: return kI2cExtSda;
      case TinyM5::Pin::ExI2cScl: return kI2cExtScl;
      case TinyM5::Pin::RgbLed: return kRgbLed;
      case TinyM5::Pin::PowerHold: return kPowerHold;
    }
    return -1;
  }
};

// The same answers for the preprocessor.
//
// `if constexpr` cannot stand in for these. Outside a template both
// arms of an `if constexpr` still go through name lookup, so a sketch
// that reaches for Board.Power on a board without a battery fails to
// compile even in the branch that is discarded. Absent hardware is
// absent rather than stubbed out, so portable sketches need #if.
#define TINYM5_HAS_DISPLAY 0
#define TINYM5_HAS_BACKLIGHT 0
#define TINYM5_HAS_BATTERY 1
#define TINYM5_HAS_DISPLAY_DSI 0
#define TINYM5_HAS_INTERNAL_I2C 1
#define TINYM5_HAS_EXTERNAL_I2C 1
#define TINYM5_HAS_RGB_LED 0
#define TINYM5_HAS_BTN_A 0
#define TINYM5_HAS_BTN_B 0
#define TINYM5_HAS_BTN_C 0
#define TINYM5_HAS_BTN_PWR 0

// The board this sketch drives, written once so that portable code can
// name it without naming the product.
#define TINYM5_BOARD TinyM5BoardTimerCam

#ifndef TINYM5_NO_GLOBAL_BOARD
// Deliberately not called `M5`: M5Unified defines a global of that name
// (M5Unified.cpp:58), so sharing it would break any sketch that also
// pulls in one of the official Unit libraries.
inline TinyM5BoardTimerCam Board;
#endif
