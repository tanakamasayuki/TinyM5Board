// TinyM5BoardAtomS3Lite
//
// The AtomS3 without the screen: an ESP32-S3 in the ATOM shell,
// one RGB LED and the front button on GPIO 41.
// No CH552 here - the S3 speaks USB itself, so the GPIO 0 bias the
// classic ATOM needs does not apply.
//
// Generated by tools/gen_boards.py - edit the catalogue there, not this file.
#pragma once

#ifdef TINYM5_BOARD
#error "TinyM5Board: one board per sketch. A second board header was included, and only the first one would have taken effect - name the one you meant."
#endif

#include <Wire.h>

#include "TinyM5Board/Common.h"
#include "TinyM5Board/Button.h"

class TinyM5BoardAtomS3Lite {
 public:
  // ---- identity ----
  static constexpr TinyM5::BoardId kBoardId = TinyM5::BoardId::AtomS3Lite;
  static constexpr TinyM5::Family kFamily = TinyM5::Family::Atom;
  static constexpr const char *kName = "M5AtomS3Lite";

  // ---- pins ----
  static constexpr int8_t kI2cSda = 38;
  static constexpr int8_t kI2cScl = 39;
  static constexpr int8_t kI2cExtSda = 2;
  static constexpr int8_t kI2cExtScl = 1;
  static constexpr int8_t kPowerHold = -1;
  /// -1: no card on the panel's SPI bus.
  static constexpr int8_t kSdSpiCs = -1;
  static constexpr int8_t kRgbLed = 35;
  static constexpr uint8_t kRgbLedCount = 1;
  static constexpr int8_t kBtnA = 41;

  // ---- what this board has ----
  // Derived from the catalogue columns, so a flag cannot disagree
  // with the thing it describes.
  static constexpr bool kHasDisplay = false;
  static constexpr bool kHasBacklight = false;
  static constexpr bool kHasBattery = false;
  static constexpr bool kHasInternalI2c = true;
  static constexpr bool kHasExternalI2c = true;
  static constexpr bool kSharesI2cBus = false;

  // ---- buttons ----
  TinyM5BoardButton BtnA{[] { return digitalRead(kBtnA) == LOW; }};

  bool begin(uint8_t flags = TinyM5::InitDefault)
  {
    if (!(flags & TinyM5::KeepSerial)) {
      Serial.begin(115200);
    }
    if (!(flags & TinyM5::KeepI2c)) {
      Wire.begin(kI2cSda, kI2cScl);
      Wire1.begin(kI2cExtSda, kI2cExtScl);
    }
    pinMode(kBtnA, INPUT_PULLUP);
    return true;
  }

  void update()
  {
    const uint32_t ms = millis();
    BtnA.update(ms);
  }

  static constexpr const char *getBoardName() { return kName; }
  static constexpr TinyM5::BoardId getBoard() { return kBoardId; }

  static constexpr int8_t getPin(TinyM5::Pin pin)
  {
    switch (pin) {
      case TinyM5::Pin::InI2cSda: return kI2cSda;
      case TinyM5::Pin::InI2cScl: return kI2cScl;
      case TinyM5::Pin::ExI2cSda: return kI2cExtSda;
      case TinyM5::Pin::ExI2cScl: return kI2cExtScl;
      case TinyM5::Pin::RgbLed: return kRgbLed;
      case TinyM5::Pin::PowerHold: return kPowerHold;
    }
    return -1;
  }
};

// The same answers for the preprocessor.
//
// `if constexpr` cannot stand in for these. Outside a template both
// arms of an `if constexpr` still go through name lookup, so a sketch
// that reaches for Board.Power on a board without a battery fails to
// compile even in the branch that is discarded. Absent hardware is
// absent rather than stubbed out, so portable sketches need #if.
#define TINYM5_HAS_DISPLAY 0
#define TINYM5_HAS_BACKLIGHT 0
#define TINYM5_HAS_BATTERY 0
#define TINYM5_HAS_DISPLAY_DSI 0
#define TINYM5_HAS_INTERNAL_I2C 1
#define TINYM5_HAS_EXTERNAL_I2C 1
#define TINYM5_HAS_RGB_LED 1
#define TINYM5_HAS_BTN_A 1
#define TINYM5_HAS_BTN_B 0
#define TINYM5_HAS_BTN_C 0
#define TINYM5_HAS_BTN_PWR 0

// The board this sketch drives, written once so that portable code can
// name it without naming the product.
#define TINYM5_BOARD TinyM5BoardAtomS3Lite

#ifndef TINYM5_NO_GLOBAL_BOARD
// Deliberately not called `M5`: M5Unified defines a global of that name
// (M5Unified.cpp:58), so sharing it would break any sketch that also
// pulls in one of the official Unit libraries.
inline TinyM5BoardAtomS3Lite Board;
#endif
