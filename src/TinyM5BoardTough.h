// TinyM5BoardTough
//
// A sealed Core2. Nothing about the screen is a pin: LDO2 feeds it,
// the chip's IO4 resets it and LDO3 dims it, so begin() has to talk
// to the AXP192 before there is anything to draw on.
// Its buttons are touch zones, not GPIOs, so only the power key is
// here. The SD card shares the LCD's SPI bus and is not yet taken
// out of SD mode - see docs/DEVELOPMENT_PLAN.ja.md.
//
// Generated by tools/gen_boards.py - edit the catalogue there, not this file.
#pragma once

#ifdef TINYM5_BOARD
#error "TinyM5Board: one board per sketch. A second board header was included, and only the first one would have taken effect - name the one you meant."
#endif

#include <Wire.h>

#include "TinyM5Board/Common.h"
#include "TinyM5Board/Button.h"
#include "TinyM5Board/PowerAxp192.h"
#include "TinyM5Board/BacklightAxp192.h"

class TinyM5BoardTough {
 public:
  // ---- identity ----
  static constexpr TinyM5::BoardId kBoardId = TinyM5::BoardId::Tough;
  static constexpr TinyM5::Family kFamily = TinyM5::Family::Core;
  static constexpr const char *kName = "M5Tough";

  // ---- pins ----
  static constexpr int8_t kI2cSda = 21;
  static constexpr int8_t kI2cScl = 22;
  static constexpr int8_t kI2cExtSda = 32;
  static constexpr int8_t kI2cExtScl = 33;
  static constexpr int8_t kPowerHold = -1;
  static constexpr int8_t kRgbLed = -1;
  static constexpr uint8_t kRgbLedCount = 0;
  static constexpr int8_t kBtnPwr = -1;

  // ---- what this board has ----
  // Derived from the catalogue columns, so a flag cannot disagree
  // with the thing it describes.
  static constexpr bool kHasDisplay = true;
  static constexpr bool kHasBacklight = true;
  static constexpr bool kHasBattery = true;
  static constexpr bool kHasExternalI2c = true;
  static constexpr bool kSharesI2cBus = false;

  // ---- power ----
  // The rails this board's schematic actually uses, and the voltages
  // that are not the chip's default. The driver knows which bit is
  // which; the board knows what they feed.
  TinyM5BoardPowerAxp192 Power{TinyM5BoardPowerAxp192::Ldo2, 3300, 0};

  // ---- backlight ----
  TinyM5BoardBacklightAxp192<TinyM5::Axp192Light::Ldo3> Backlight{Power};

  // ---- buttons ----
  // Some of these are not pins on the SoC - they live in the
  // power chip or the expander and are read over I2C, so those
  // are rate limited to the debounce interval.
  TinyM5BoardButton BtnPwr{
      [](void *p) {
        return static_cast<TinyM5BoardPowerAxp192 *>(p)->isKeyPressed();
      },
      &Power, true};

  bool begin(uint8_t flags = TinyM5::InitDefault)
  {
    if (!(flags & TinyM5::KeepSerial)) {
      Serial.begin(115200);
    }
    if (!(flags & TinyM5::KeepI2c)) {
      Wire.begin(kI2cSda, kI2cScl);
      Wire1.begin(kI2cExtSda, kI2cExtScl);
    }
    // The chip is soldered on, so no answer is a real fault. The
    // rails have to be up before the panel is taken out of reset.
    const bool ok = Power.begin(Wire);
    // Nothing here is a pin. IO4 is the panel's reset line and IO1 is the
    // touch controller's, so both have to be configured on the chip before
    // either can be pulsed. (M5GFX.cpp reg_data_axp192_first)
    Power.gpioOutput(TinyM5BoardPowerAxp192::Gpio::Io4);     // LCD RST
    Power.gpioOpenDrain(TinyM5BoardPowerAxp192::Gpio::Io1);  // touch RST
    Power.gpioResetPulse(TinyM5BoardPowerAxp192::Gpio::Io4);
    Power.gpioResetPulse(TinyM5BoardPowerAxp192::Gpio::Io1);
    Backlight.begin();
    return ok;
  }

  void update()
  {
    const uint32_t ms = millis();
    BtnPwr.update(ms);
  }

  /// Everything a graphics library needs to drive this panel. This
  /// library owns no driver and draws nothing.
  static constexpr TinyM5::Display display()
  {
    return TinyM5::Display{
        /*mosi*/ 23, /*miso*/ 38, /*sclk*/ 18,
        /*dc*/ 15, /*cs*/ 5,
        /*rst*/ -1,  // begin() has already pulsed it
        /*freqWrite*/ 40000000, /*freqRead*/ 16000000,
        /*width*/ 320, /*height*/ 240,
        /*offsetX*/ 0, /*offsetY*/ 0,
        /*rotation*/ 3, /*invert*/ true,
        /*threeWire*/ true};
  }

  static constexpr const char *getBoardName() { return kName; }
  static constexpr TinyM5::BoardId getBoard() { return kBoardId; }

  static constexpr int8_t getPin(TinyM5::Pin pin)
  {
    switch (pin) {
      case TinyM5::Pin::InI2cSda: return kI2cSda;
      case TinyM5::Pin::InI2cScl: return kI2cScl;
      case TinyM5::Pin::ExI2cSda: return kI2cExtSda;
      case TinyM5::Pin::ExI2cScl: return kI2cExtScl;
      case TinyM5::Pin::RgbLed: return kRgbLed;
      case TinyM5::Pin::PowerHold: return kPowerHold;
    }
    return -1;
  }
};

// The same answers for the preprocessor.
//
// `if constexpr` cannot stand in for these. Outside a template both
// arms of an `if constexpr` still go through name lookup, so a sketch
// that reaches for Board.Power on a board without a battery fails to
// compile even in the branch that is discarded. Absent hardware is
// absent rather than stubbed out, so portable sketches need #if.
#define TINYM5_HAS_DISPLAY 1
#define TINYM5_HAS_BACKLIGHT 1
#define TINYM5_HAS_BATTERY 1
#define TINYM5_HAS_EXTERNAL_I2C 1
#define TINYM5_HAS_RGB_LED 0
#define TINYM5_HAS_BTN_A 0
#define TINYM5_HAS_BTN_B 0
#define TINYM5_HAS_BTN_C 0
#define TINYM5_HAS_BTN_PWR 1

// The board this sketch drives, written once so that portable code can
// name it without naming the product.
#define TINYM5_BOARD TinyM5BoardTough

#ifndef TINYM5_NO_GLOBAL_BOARD
// Deliberately not called `M5`: M5Unified defines a global of that name
// (M5Unified.cpp:58), so sharing it would break any sketch that also
// pulls in one of the official Unit libraries.
inline TinyM5BoardTough Board;
#endif
