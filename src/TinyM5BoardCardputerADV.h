// TinyM5BoardCardputerADV
//
// The Cardputer with an internal I2C bus of its own on GPIO 8/9,
// where the plain one has only the Grove port. Same panel, same
// button, same battery; upstream tells the two apart by probing
// those pins.
//
// Generated by tools/gen_boards.py - edit the catalogue there, not this file.
#pragma once

#ifdef TINYM5_BOARD
#error "TinyM5Board: one board per sketch. A second board header was included, and only the first one would have taken effect - name the one you meant."
#endif

#include <Wire.h>

#include "TinyM5Board/Common.h"
#include "TinyM5Board/Button.h"
#include "TinyM5Board/PowerAdc.h"
#include "TinyM5Board/BacklightPwm.h"

class TinyM5BoardCardputerADV {
 public:
  // ---- identity ----
  static constexpr TinyM5::BoardId kBoardId = TinyM5::BoardId::CardputerADV;
  static constexpr TinyM5::Family kFamily = TinyM5::Family::Other;
  static constexpr const char *kName = "M5CardputerADV";

  // ---- pins ----
  static constexpr int8_t kI2cSda = 8;
  static constexpr int8_t kI2cScl = 9;
  static constexpr int8_t kI2cExtSda = 2;
  static constexpr int8_t kI2cExtScl = 1;
  static constexpr int8_t kPowerHold = -1;
  /// -1: no card on the panel's SPI bus.
  static constexpr int8_t kSdSpiCs = -1;
  static constexpr int8_t kRgbLed = 21;
  static constexpr uint8_t kRgbLedCount = 1;
  static constexpr int8_t kBtnA = 0;

  // ---- what this board has ----
  // Derived from the catalogue columns, so a flag cannot disagree
  // with the thing it describes.
  static constexpr bool kHasDisplay = true;
  static constexpr bool kHasBacklight = true;
  static constexpr bool kHasBattery = true;
  static constexpr bool kHasInternalI2c = true;
  static constexpr bool kHasExternalI2c = true;
  static constexpr bool kSharesI2cBus = false;

  // ---- power ----
  TinyM5BoardPowerAdc Power{10, 2000};

  // ---- backlight ----
  TinyM5BoardBacklightPwm Backlight{38, 256, 16};

  // ---- buttons ----
  TinyM5BoardButton BtnA{[] { return digitalRead(kBtnA) == LOW; }};

  bool begin(uint8_t flags = TinyM5::InitDefault)
  {
    if (!(flags & TinyM5::KeepSerial)) {
      Serial.begin(115200);
    }
    if (!(flags & TinyM5::KeepI2c)) {
      Wire.begin(kI2cSda, kI2cScl);
      Wire1.begin(kI2cExtSda, kI2cExtScl);
    }
    pinMode(kBtnA, INPUT_PULLUP);
    Power.begin();
    TinyM5::resetPulse(33);
    Backlight.begin();
    return true;
  }

  void update()
  {
    const uint32_t ms = millis();
    BtnA.update(ms);
  }

  /// Everything a graphics library needs to drive this panel. This
  /// library owns no driver and draws nothing.
  static constexpr TinyM5::Display display()
  {
    return TinyM5::Display{
        /*bus*/ TinyM5::DisplayBus::Spi,
        /*mosi*/ 35, /*miso*/ -1, /*sclk*/ 36,
        /*dc*/ 34, /*cs*/ 37,
        /*io2*/ -1, /*io3*/ -1,
        /*rst*/ -1,  // begin() has already pulsed it
        /*busy*/ -1,
        /*freqWrite*/ 40000000, /*freqRead*/ 16000000,
        /*width*/ 135, /*height*/ 240,
        /*offsetX*/ 52, /*offsetY*/ 40,
        /*rotation*/ 0, /*invert*/ true,
        /*threeWire*/ true};
  }

  static constexpr const char *getBoardName() { return kName; }
  static constexpr TinyM5::BoardId getBoard() { return kBoardId; }

  static constexpr int8_t getPin(TinyM5::Pin pin)
  {
    switch (pin) {
      case TinyM5::Pin::InI2cSda: return kI2cSda;
      case TinyM5::Pin::InI2cScl: return kI2cScl;
      case TinyM5::Pin::ExI2cSda: return kI2cExtSda;
      case TinyM5::Pin::ExI2cScl: return kI2cExtScl;
      case TinyM5::Pin::RgbLed: return kRgbLed;
      case TinyM5::Pin::PowerHold: return kPowerHold;
    }
    return -1;
  }
};

// The same answers for the preprocessor.
//
// `if constexpr` cannot stand in for these. Outside a template both
// arms of an `if constexpr` still go through name lookup, so a sketch
// that reaches for Board.Power on a board without a battery fails to
// compile even in the branch that is discarded. Absent hardware is
// absent rather than stubbed out, so portable sketches need #if.
#define TINYM5_HAS_DISPLAY 1
#define TINYM5_HAS_BACKLIGHT 1
#define TINYM5_HAS_BATTERY 1
#define TINYM5_HAS_DISPLAY_DSI 0
#define TINYM5_HAS_INTERNAL_I2C 1
#define TINYM5_HAS_EXTERNAL_I2C 1
#define TINYM5_HAS_RGB_LED 1
#define TINYM5_HAS_BTN_A 1
#define TINYM5_HAS_BTN_B 0
#define TINYM5_HAS_BTN_C 0
#define TINYM5_HAS_BTN_EXT 0
#define TINYM5_HAS_BTN_PWR 0

// The board this sketch drives, written once so that portable code can
// name it without naming the product.
#define TINYM5_BOARD TinyM5BoardCardputerADV

#ifndef TINYM5_NO_GLOBAL_BOARD
// Deliberately not called `M5`: M5Unified defines a global of that name
// (M5Unified.cpp:58), so sharing it would break any sketch that also
// pulls in one of the official Unit libraries.
inline TinyM5BoardCardputerADV Board;
#endif
